cln {
  bindings = <
    &trans  &trans  &trans  &trans  &trans  &trans  &trans                                              &trans  &trans  &trans  &trans  &trans  &trans  &trans
    &trans  &trans  &trans  &trans  &trans  &trans  &trans                                              &trans  &trans  &trans  &trans  &trans  &trans  &trans
    &trans  &trans  &trans  &trans  &trans  &trans  &trans        &trans  &trans  &trans  &trans        &trans  &trans  &trans  &trans  &trans  &trans  &trans
    &trans  &trans  &trans  &trans  &trans  &trans                        &trans  &trans                        &trans  &trans  &trans  &trans  &trans  &trans
    &trans  &trans  &trans  &trans  &trans                &trans  &trans  &trans  &trans  &trans  &trans                &trans  &trans  &trans  &trans  &trans
  >;
};
